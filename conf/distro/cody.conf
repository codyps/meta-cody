## conf/distro/cody.conf
```bitbake
require conf/distro/poky.conf

DISTRO = "cody"
DISTRO_NAME = "cody"

DISTRO_FEATURES_BACKFILL_CONSIDERED = "sysvinit"

PREFERRED_PROVIDER_udev ?= "systemd"
PREFERRED_PROVIDER_udev-utils ?= "systemd"
VIRTUAL-RUNTIME_init_manager = "systemd"
VIRTUAL-RUNTIME_initscripts = ""

POKY_DEFAULT_DISTRO_FEATURES = "\
    largefile \
    pam \
    systemd \
"

DISTRO_FEATURES_remove = "x11 directfb"
```

## conf/layer.conf
```bitbake
# We have a conf and classes directory, add to BBPATH
BBPATH .= ":${LAYERDIR}"

# We have recipes-* directories, add to BBFILES
BBFILES += "${LAYERDIR}/recipes-*/*/*.bb \
	${LAYERDIR}/recipes-*/*/*.bbappend"

BBFILE_COLLECTIONS += "cody-layer"
BBFILE_PATTERN_cody-layer = "^${LAYERDIR}/"
BBFILE_PRIORITY_cody-layer = "6"

# This should only be incremented on significant changes that will
# cause compatibility issues with other layers
LAYERVERSION_cody-layer = "1"
LAYERDEPENDS_cody-layer = "core"

LAYERSERIES_COMPAT_cody-layer = "gatesgarth"
```
